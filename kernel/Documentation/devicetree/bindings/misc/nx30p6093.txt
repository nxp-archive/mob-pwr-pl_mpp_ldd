## kernel/Documentation/devicetree/bindings/misc/nx30p6093.txt
```
Binding for NXP NX30P6093 OVP

Required properties:
- compatible: Should contain one of the following:
    * "nxp,nx30p6093"
- reg: integer, i2c address of the device.
	   It should be "0x36"
- nx30p6093,irq-gpio: integer, AP gpio number;
- nx30p6093,en-gpio: integer, AP gpio number;
- nx30p6093,vin-tag-voltage: integer, uV unit;

Example:
nx30p6093@36 {
        compatible = "nxp,nx30p6093";
        reg = <0x36>;
		
        nx30p6093,irq-gpio = <xxx>;
        nx30p6093,en-gpio = <yyy>;
		nx30p6093,vin-tag-voltage = <1820000>;	// 1.82V
};
```

## kernel/Documentation/devicetree/bindings/power/pca9468_charger.txt
```
Binding for NXP PCA9468 2:1 Direct Charger

Required properties:
- compatible: Should contain one of the following:
    * "nxp,pca9468"
- reg: integer, i2c address of the device.
	   It depends on ADD pin state.
	   ADD:high-0x55, ADD:low-0x57, ADD:Hi-Z-0x5E
- pca9468,irq-gpio: integer, AP gpio number;
- pca9468,input-current-limit: integer, input current limit (in uA);
- pca9468,charging-current: integer, charging current (in uA);
- pca9468,float-voltage: integer, charging float voltage (in uV);
- pca9468,sense-resistance: integer, 0-5mOhm, 1-10mOhm

Example:
pca9468@57 {
        compatible = "nxp,pca9468";
        reg = <0x57>;
		usbpd-phy = <&pmi8998_pdphy>;
		
        pca9468,irq-gpio = <xxx>;
        pca9468,input-current-limit = <2500000>;
        pca9468,charging-current = <6000000>;
        pca9468,float-voltage = <4350000>;
        pca9468,sense-resistance = <1>;
};
```

## kernel/Documentation/devicetree/bindings/power/pca9491_charger.txt
```
Binding for NXP PCA9491 1:1 Direct Charger

Required properties:
- compatible: Should contain one of the following:
    * "nxp,pca9491"
- reg: integer, i2c address of the device.
	   It depends on ADD pin state.
	   ADD:high-0x65, ADD:Hi-Z-0x66, ADD:low-0x67
- pca9491,irq-gpio: integer, AP gpio number;
- pca9491,en-gpio: integer, AP gpio number;
- pca9491,input-current-limit: integer, input current limit (in uA);
- pca9491,charging-current: integer, charging current (in uA);
- pca9491,float-voltage: integer, charging float voltage (in uV);
- pca9491,topoff-current: integer, topoff current (in uA);
- pca9491,sense-resistor: integer, 0-5mOhm, 1-10mOhm
- pca9491,vbus-ovp: integer, vbus overvoltage threshold (in uV);
- pca9491,vout-reg: integer, vout regulator loop threshold (in uV);
- pca9491,vdrop-ovp: integer, vdrop overvoltage threshold (in uV);
- pca9491,vdrop-alarm: integer, vdrop alarm threshold (in uV)

Example:
pca9491@67 {
        compatible = "nxp,pca9491";
        reg = <0x67>;
		usbpd-phy = <&pmi8998_pdphy>;
		
        pca9491,irq-gpio = <xxx>;
	pca9491,en-gpio = <yyy>;
        pca9491,input-current-limit = <2500000>;
        pca9491,charging-current = <6000000>;
        pca9491,float-voltage = <4350000>;
	pca9491,topoff-current = <500000>;
        pca9491,sense-resistor = <1>;
	pca9491,vbus-ovp = <5500000>;
	pca9491,vout-reg = <4500000>;
	pca9491,vdrop-ovp = <300000>;
	pca9491,vdrop-alarm = <100000>;
};
```
